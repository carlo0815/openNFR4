## meta-brands/meta-formuler/conf/machine/formuler1.conf
```bitbake
#@TYPE: Machine
#@NAME: Formuler F1
#@DESCRIPTION: Machine configuration for the Formuler F1

MACHINE_NAME = "F1"

PREFERRED_VERSION_linux-formuler = "4.0.1"
PREFERRED_VERSION_linux-libc-headers = "4.0"

CHIPSET = "bcm7356"

UBI_VOLNAME = "rootfs"
MKUBIFS_ARGS = "-m 2048 -e 126976 -c 8192"
UBINIZE_ARGS = "-m 2048 -p 128KiB"

require conf/machine/include/formuler.inc

MACHINE_FEATURES += "dvb-c ci textlcd videoenhancement gles directfb sdl skins1080 nfrledcontrol"

MACHINE_EXTRA_RDEPENDS = "\
    \
    ${@base_contains('MACHINE_DRIVER', 'formuler1', 'rt3070 firmware-rt2870' , '', d)} \
    ${@base_contains('MACHINE_DRIVER', 'formuler1', 'rt3070 firmware-rt3070' , '', d)} \
    "
```
